## Documentation/devicetree/bindings/net/microchip,enc624j600-psp.yaml
```yaml
# SPDX-License-Identifier: GPL-2.0-only OR BSD-2-Clause
%YAML 1.2
---
$id: http://devicetree.org/schemas/net/microchip,enc624j600-psp.yaml#
$schema: http://devicetree.org/meta-schemas/core.yaml#

title: Microchip ENC624J600 Ethernet MAC (PSP)

maintainers:
  - Stephan Wurm <stephan.wurm@a-eberle.de>

properties:
  compatible:
    const: microchip,enc624j600-psp

  reg:
    maxItems: 1

  interrupts:
    maxItems: 1

required:
  - compatible
  - reg
  - interrupts

allOf:
  - $ref: ethernet-controller.yaml#

unevaluatedProperties: false

examples:
  - |
    /* i.MX6 WEIM parallel interface */
    &weim {
        pinctrl-names = "ebibus";
        pinctrl-0 = <&pinctrl_ebibus>;
        status = "okay";
        ranges = <0 0 0x08000000 0x08000000>;

        ethernet@0,0 {
            compatible = "microchip,enc624j600-psp";
            reg = <0 0 0x10000>;
            interrupt-parent = <&gpio2>;
            interrupts = <11 2>;
            #address-cells = <1>;
            #size-cells = <1>;
            /* multiplexed external bus (enc mode9) */
            fsl,weim-cs-timing = <0x00010089 0x00001001 0x0a000100
                                  0x00000000 0x09000400 0x00000000>;
        };

    };
```
